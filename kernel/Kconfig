## kernel/Kconfig
```kconfig
menu "KernelSU"

config KSU
	tristate "KernelSU function support"
	depends on KPROBES && EXT4_FS
	default y
	help
	  Enable kernel-level root privileges on Android System.
	  Requires CONFIG_KPROBES for kernel hooking support.
	  Requires CONFIG_EXT4_FS for `ext4_unregister_sysfs`.
	  To compile as a module, choose M here: the
	  module will be called kernelsu.

config KSU_DEBUG
	bool "KernelSU debug mode"
	depends on KSU
	default n
	help
	  Enable KernelSU debug mode.

config KSU_DISABLE_MANAGER
	bool "Disable KernelSU manager integration"
	depends on KSU
	default n
	help
	  Disable manager APK detection and manager-specific handling.
	  Root will be used in place of manager-only functionality.

config KSU_DISABLE_POLICY
	bool "Disable KernelSU policy profiles"
	depends on KSU
	default n
	help
	  Disable per-app root/non-root profile customization.
	  Escalation will always use the default full root profile, and
	  non-root handling will follow the global umount policy only.

config KSU_X86_PATCH_SYSCALL_DISPATCHER
	bool "Dynamically patch x64's hardened syscall dispatcher to support syscall hooks"
	depends on KSU && X86_64
	default n
	help
	  Dynamically patch x64's hardened syscall dispatcher to support syscall hooks. This is a
	  replacement for a kernel source code patch, and is useful for x86_64 LKM mode.

config KSU_SAMSUNG_KDP
	bool "Samsung KDP credential support"
	depends on KSU && ARM64
	default n
	help
	  Install credentials through Samsung KDP read-only credential and PGD
	  interfaces.  A device without those helpers keeps the standard credential
	  path instead of failing the module load.

config KSU_SAMSUNG_DEFEX
	bool "Samsung DEFEX synchronization"
	depends on KSU && ARM64 && KPROBES
	default n
	help
	  Synchronize DEFEX credential state and bypass enforcement for a current
	  task already running as root in the KernelSU SELinux domain, and for the
	  task that loaded this module (which is DEFEX-visible before it enters
	  that domain).

endmenu
```
